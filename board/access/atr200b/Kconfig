## board/access/atr200b/Kconfig
```kconfig
if TARGET_ATR200B

config SYS_BOARD
	default "atr200b"

config SYS_VENDOR
	default "access"

config SYS_CONFIG_NAME
	default "atr200b"

endif
```

## board/access/s16/Kconfig
```kconfig
if TARGET_S16

config SYS_BOARD
	default "s16"

config SYS_VENDOR
	default "access"

config SYS_CONFIG_NAME
	default "s16"

endif
```

## board/access/swallow/Kconfig
```kconfig
if TARGET_SWALLOW

config SYS_BOARD
	default "swallow"

config SYS_VENDOR
	default "access"

config SYS_CONFIG_NAME
	default "swallow"

endif
```

## board/access/val100/Kconfig
```kconfig
if TARGET_VAL100

config SYS_BOARD
	default "val100"

config SYS_VENDOR
	default "access"

config SYS_CONFIG_NAME
	default "val100"

endif
```

## configs/S16_defconfig
```kconfig
CONFIG_ARM=y
CONFIG_ARCH_MX6=y
CONFIG_TARGET_S16=y
CONFIG_DISTRO_DEFAULTS=y
CONFIG_SYS_EXTRA_OPTIONS="IMX_CONFIG=board/access/s16/imximage.cfg,MX6QDL"
CONFIG_BOARD_EARLY_INIT_F=y
CONFIG_CMD_MMC=y
CONFIG_CMD_USB=y
CONFIG_CMD_GPIO=y
CONFIG_CMD_CACHE=y
CONFIG_CMD_EXT4_WRITE=y
CONFIG_DM=y
CONFIG_DM_THERMAL=y
CONFIG_USB=y
CONFIG_USB_STORAGE=y
CONFIG_USB_KEYBOARD=y
CONFIG_OF_LIBFDT=y
CONFIG_SPI_FLASH=y
CONFIG_SPI_FLASH_SPANSION=y
CONFIG_HAS_THUMB2=y
CONFIG_SYS_THUMB_BUILD=y
```

## configs/atr200b_defconfig
```kconfig
CONFIG_CREATE_ARCH_SYMLINK=y
CONFIG_ARM=y
CONFIG_SYS_ARCH="arm"
CONFIG_SYS_CPU="armv7"
CONFIG_SYS_SOC="mx6"
CONFIG_SYS_VENDOR="access"
CONFIG_SYS_BOARD="atr200b"
CONFIG_SYS_CONFIG_NAME="atr200b"
CONFIG_HAS_VBAR=y
CONFIG_HAS_THUMB2=y
CONFIG_ARM_ASM_UNIFIED=y
CONFIG_ARM_ERRATA_743622=y
CONFIG_ARM_ERRATA_751472=y
CONFIG_ARM_ERRATA_761320=y
CONFIG_ARM_ERRATA_794072=y
CONFIG_ARM_ERRATA_845369=y
CONFIG_CPU_V7=y
CONFIG_SYS_ARM_ARCH=7
CONFIG_SYS_CACHE_SHIFT_6=y
CONFIG_SYS_CACHELINE_SIZE=64
CONFIG_SYS_THUMB_BUILD=y
CONFIG_USE_ARCH_MEMCPY=y
CONFIG_USE_ARCH_MEMSET=y
CONFIG_ARCH_MX6=y
CONFIG_SPL_LDSCRIPT="arch/arm/mach-omap2/u-boot-spl.lds"
CONFIG_SYS_MALLOC_F_LEN=0x400
CONFIG_MX6_SMP=y
CONFIG_MX6=y
CONFIG_MX6DL=y
CONFIG_TARGET_ATR200B=y
CONFIG_IDENT_STRING=""
CONFIG_SPL_BOOT_DEVICE_SPI_FLASH=y
CONFIG_HAS_CAAM=y
CONFIG_GPT_TIMER=y
CONFIG_LOCALVERSION=""
CONFIG_LOCALVERSION_AUTO=y
CONFIG_CC_OPTIMIZE_FOR_SIZE=y
CONFIG_SYS_MALLOC_F=y
CONFIG_SPL_SYS_MALLOC_F_LEN=0x400
CONFIG_TPL_SYS_MALLOC_F_LEN=0x400
CONFIG_EXPERT=y
CONFIG_SYS_MALLOC_CLEAR_ON_INIT=y
CONFIG_SYS_EXTRA_OPTIONS="IMX_CONFIG=board/access/atr200b/imximage.cfg,MX6QDL"
CONFIG_ARCH_FIXUP_FDT_MEMORY=y
CONFIG_BOOTSTAGE_RECORD_COUNT=30
CONFIG_SPL_BOOTSTAGE_RECORD_COUNT=5
CONFIG_BOOTSTAGE_STASH_ADDR=0
CONFIG_BOOTSTAGE_STASH_SIZE=0x1000
CONFIG_BOOTDELAY=2
CONFIG_LOGLEVEL=4
CONFIG_SPL_LOGLEVEL=4
CONFIG_SYS_STDIO_DEREGISTER=y
CONFIG_DEFAULT_FDT_FILE=""
CONFIG_BOARD_LATE_INIT=y
CONFIG_DISPLAY_CPUINFO=y
CONFIG_DISPLAY_BOARDINFO=y
CONFIG_BOARD_EARLY_INIT_F=y
CONFIG_HASH=y
CONFIG_CMDLINE=y
CONFIG_HUSH_PARSER=y
CONFIG_SYS_PROMPT="=> "
CONFIG_AUTOBOOT=y
CONFIG_CMD_BDI=y
CONFIG_CMD_CONSOLE=y
CONFIG_CMD_BOOTM=y
CONFIG_CMD_BOOTZ=y
CONFIG_CMD_FDT=y
CONFIG_CMD_RUN=y
CONFIG_CMD_EXPORTENV=y
CONFIG_CMD_IMPORTENV=y
CONFIG_CMD_EDITENV=y
CONFIG_CMD_SAVEENV=y
CONFIG_CMD_ENV_EXISTS=y
CONFIG_CMD_CRC32=y
CONFIG_CMD_MEMORY=y
CONFIG_CMD_ECHO=y
CONFIG_SUPPORT_OF_CONTROL=y
CONFIG_MKIMAGE_DTC_PATH="dtc"
CONFIG_ENV_IS_IN_SPI_FLASH=y
CONFIG_DM=y
CONFIG_DM_WARN=y
CONFIG_DM_DEVICE_REMOVE=y
CONFIG_DM_STDIO=y
CONFIG_DM_SEQ_ALIAS=y
CONFIG_DM_DEV_READ_INLINE=y
CONFIG_SYS_FSL_SEC_COMPAT_4=y
CONFIG_SYS_FSL_SEC_LE=y
CONFIG_SPI_FLASH=y
CONFIG_SPI_FLASH_SPANSION=y
CONFIG_BAUDRATE=115200
CONFIG_DM_THERMAL=y
CONFIG_CC_OPTIMIZE_LIBS_FOR_SPEED=y
CONFIG_HAVE_PRIVATE_LIBGCC=y
CONFIG_SYS_HZ=1000
CONFIG_OF_LIBFDT=y
```
